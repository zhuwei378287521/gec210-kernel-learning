## gec_linux/drivers/media/video/samsung/fimc/Kconfig
```kconfig
config VIDEO_FIMC
	bool "Samsung Camera Interface (FIMC) driver"
	depends on VIDEO_SAMSUNG && ARCH_S5PV210
	default n
	help
	  This is a video4linux driver for Samsung FIMC device.

choice
depends on VIDEO_FIMC
prompt "Select Camera"
default VIDEO_OV9650
config VIDEO_OV9650
        bool "camera ov9650 module"
        depends on VIDEO_FIMC
        help
          OV9650 FOR GEC210

config VIDEO_TVP5150
        bool "camera tvp5150 module"
        depends on VIDEO_FIMC
        help
          TVP5150 FOR GEC210        

endchoice

choice
depends on VIDEO_FIMC
prompt "Select CSC Range config"
default VIDEO_FIMC_RANGE_NARROW
config VIDEO_FIMC_RANGE_NARROW
	bool "Narrow"
	depends on VIDEO_FIMC && ARCH_S5PV210
	---help---
	  RGB <-> YUV Color Conversion Narrow Range Equation

config VIDEO_FIMC_RANGE_WIDE
	bool "Wide"
	depends on VIDEO_FIMC && ARCH_S5PV210
	---help---
	  RGB <-> YUV Color Conversion Wide Range Equation
endchoice	

config VIDEO_FIMC_DEBUG
	bool "FIMC driver debug messages"
	depends on VIDEO_FIMC

config VIDEO_FIMC_MIPI
	bool "MIPI-CSI2 Slave Interface support"
	depends on VIDEO_FIMC && ARCH_S5PV210
	default y
```

## gec_linux/drivers/video/logo/Kconfig
```kconfig
#
# Logo configuration
#

menuconfig LOGO
	bool "Bootup logo"
	depends on FB || SGI_NEWPORT_CONSOLE
	help
	  Enable and select frame buffer bootup logos.

if LOGO

config FB_LOGO_EXTRA
	bool
	depends on FB=y
	default y if SPU_BASE

config LOGO_LINUX_MONO
	bool "Standard black and white Linux logo"
	default y

config LOGO_LINUX_VGA16
	bool "Standard 16-color Linux logo"
	default y

config LOGO_LINUX_320240
	bool "Standard 320240 224-color Linux logo"
	default n

config LOGO_LINUX_GEC480272
	bool "For GEC 4.3inch LCD module resolution is 480*272"
	default y

config LOGO_LINUX_GEC800480
	bool "For GEC 7inch LCD module resolution is 800*480"
	default n

config LOGO_LINUX_GEC1024768
	bool "For GEC  VGA disaplay resolution is 1024*768  "
	default n

config LOGO_LINUX_GEC800600
	bool "For GEC VGA800600 display"
	default n

config LOGO_BLACKFIN_VGA16
	bool "16-colour Blackfin Processor Linux logo"
	depends on BLACKFIN
	default y

config LOGO_BLACKFIN_CLUT224
	bool "224-colour Blackfin Processor Linux logo"
	depends on BLACKFIN
	default y

config LOGO_DEC_CLUT224
	bool "224-color Digital Equipment Corporation Linux logo"
	depends on MACH_DECSTATION || ALPHA
	default y

config LOGO_MAC_CLUT224
	bool "224-color Macintosh Linux logo"
	depends on MAC
	default y

config LOGO_PARISC_CLUT224
	bool "224-color PA-RISC Linux logo"
	depends on PARISC
	default y

config LOGO_SGI_CLUT224
	bool "224-color SGI Linux logo"
	depends on SGI_IP22 || SGI_IP27 || SGI_IP32 || X86_VISWS
	default y

config LOGO_SUN_CLUT224
	bool "224-color Sun Linux logo"
	depends on SPARC
	default y

config LOGO_SUPERH_MONO
	bool "Black and white SuperH Linux logo"
	depends on SUPERH
	default y

config LOGO_SUPERH_VGA16
	bool "16-color SuperH Linux logo"
	depends on SUPERH
	default y

config LOGO_SUPERH_CLUT224
	bool "224-color SuperH Linux logo"
	depends on SUPERH
	default y

config LOGO_M32R_CLUT224
	bool "224-color M32R Linux logo"
	depends on M32R
	default y

endif # LOGO
```
